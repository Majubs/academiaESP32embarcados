## aula-dac/main/Kconfig.projbuild
```kconfig
# put here your custom config value
menu "Wave form"
choice WAVE_TYPE
    prompt "Select wave type"
    default WAVE_SIN
    help
        Select one of three wave types:
         * Sin
         * Triangle
         * Serrated
    config WAVE_SIN
        bool "Sin"
    config WAVE_TRIANGLE
        bool "Triangle"
    config WAVE_SERRATED
        bool "Serrated"
endchoice
endmenu
```

## aula-mqtt/components/mqtt_app/Kconfig.projbuild
```kconfig
menu "MQTT Configuration"

    config BROKER_URL
        string "Broker URL"
        default "mqtt://mqtt.eclipseproject.io"
        help
            Broker for MQTT connection
endmenu
```

## teste-vscode/main/Kconfig.projbuild
```kconfig
# put here your custom config value
menu "Example Blink"
config BLINK_GPIO
    int "Blink GPIO number"
    range 0 10
    default 5
    help
        GPIO number (IOxx) to blink LED on and off.

        GPIOs 35-39 are input only!
endmenu
```
